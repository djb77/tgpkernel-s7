## arch/arm64/configs/hero2lte_defconfig
```kconfig
#
# Modifications for Samsung Galaxy S7 Edge (hero2lte)
#
CONFIG_WLAN_HERO2=y
CONFIG_FB_DSU_REG_LOCK=y
CONFIG_EXYNOS_DECON_LCD_MCD=y
CONFIG_PANEL_S6E3HF4_WQHD=y
CONFIG_SENSORS_SX9310_NORMAL_TOUCH_THRESHOLD=168
CONFIG_SENSORS_HERO2=y
```

## arch/arm64/configs/herolte_defconfig
```kconfig
#
# Modifications for Samsung Galaxy S7 (herolte)
#
CONFIG_WLAN_HERO=y
CONFIG_LCD_ESD_IDLE_MODE=y
CONFIG_PANEL_S6E3HA3_DYNAMIC=y
CONFIG_SENSORS_SX9310_NORMAL_TOUCH_THRESHOLD=176
```
